/*  Скетч демонстрирует управление цветами светодиодов, как по отдельности, так и всем сразу
 *  Номер вывода Arduino и количество используемых светодиодов указывается при объявлении объекта led(вывод,количество)
 */

#include <iarduino_NeoPixel.h>                       //  Подключаем библиотеку iarduino_NeoPixel для работы со светодиодами NeoPixel
iarduino_NeoPixel led(7,4);                          //  Объявляем объект LED указывая (№ вывода Arduino к которому подключены светодиоды NeoPixel, количество используемых светодиодов)

void setup(){
    Serial.begin(9600);                              //  Инициируем передачу данных в монитор последовательного порта
    if(led.begin()) {Serial.println("Ok");}          //  Инициируем работу со светодиодами и выводим сообщение об успешной инициализации
    else            {Serial.println("Err");}         //  Если инициализация невозможна (не хватает памяти для хранения цветов всех светодиодов), то выводим сообщение об ошибке
}

void loop(){
//  ====== ОДИН ЦВЕТ НА ВСЕ СВЕТОДИОДЫ ======
    led.setColor(NeoPixelAll, 255,0,0);              //  Устанавливаем красный цвет для всех светодиодов (все,R,G,B)
    led.write();                                     //  Записываем
    delay(1000);                                     //  Ждём 1 секунду, чтоб его увидеть )))
    led.setColor(NeoPixelAll, 0x00FF00);             //  Устанавливаем зелёный цвет на всех светодиодах (все,RGB) Данная конструкция удобна тем, что Вы можете копировать цвет прямо из графических редакторов (например из Photoshop, Corel и т.д.)
    led.write();                                     //  Записываем
    delay(1000);                                     //  Ждём 1 секунду, чтоб увидеть зелёный цвет
//  ====== ОДИН ЦВЕТ НА ОДИН СВЕТОДИОД ======
    led.setColor(0, 255,0,0);                        //  Устанавливаем красный цвет для 0 светодиода (0,R,G,B)
                                                     //  Светодиод №1 оставляем без изменений, на нём сохранится, установленный ранее, зелёный цвет
    led.setColor(2, 0,0,255);                        //  Устанавливаем синий   цвет для 2 светодиода (2,R,G,B)
    led.setColor(3, 0xFF,0xFF,0);                    //  Устанавливаем жёлтый  цвет для 3 светодиода (3,R,G,B)
    led.write();                                     //  Записываем
    delay(1000);                                     //  Ждём 1 секунду, чтоб увидеть четыре разных цвета
//  ====== МЕНЯЕМ ЯРКОСТЬ ЦВЕТА =============
    for(int i=127; i<=255; i++){                     //  Увеличиваем яркость i от 127 (стандартная яркость) до 255 (максимальная яркость)
        led.setColor(0, 0xFF0000, i);                //  Устанавливаем красный цвет на 0 светодиоде и яркость (0,RGB,яркость)
        led.setColor(1, 0x00FF00, i);                //  Устанавливаем зелёный цвет на 1 светодиоде и яркость (1,RGB,яркость)
        led.setColor(2, 0x0000FF, i);                //  Устанавливаем синий   цвет на 2 светодиоде и яркость (2,RGB,яркость)
        led.setColor(3, 0xFFFF00, i);                //  Устанавливаем жёлтый  цвет на 3 светодиоде и яркость (3,RGB,яркость)
        led.write(); delay(5);                       //  Записываем и ждём 5 мс, чтоб изменение яркости было плавным
    }
    for(int i=255; i>0; i--){                        //  Уменьшаем яркость i от 255 (максимальная яркость) до 0 (минимальная яркость)
        led.setColor(0, 0xFF0000, i);                //  Устанавливаем красный цвет на 0 светодиоде и яркость (0,RGB,яркость)
        led.setColor(1, 0x00FF00, i);                //  Устанавливаем зелёный цвет на 1 светодиоде и яркость (1,RGB,яркость)
        led.setColor(2, 0x0000FF, i);                //  Устанавливаем синий   цвет на 2 светодиоде и яркость (2,RGB,яркость)
        led.setColor(3, 0xFFFF00, i);                //  Устанавливаем жёлтый  цвет на 3 светодиоде и яркость (3,RGB,яркость)
        led.write(); delay(5);                       //  Записываем и ждём 5 мс, чтоб изменение яркости было плавным
    }
    for(int i=0; i<=127; i++){                       //  Увеличиваем яркость i от 0 (минимальная яркость) до 127 (стандартная яркость)
        led.setColor(0, 0xFF0000, i);                //  Устанавливаем красный цвет на 0 светодиоде и яркость (0,RGB,яркость)
        led.setColor(1, 0x00FF00, i);                //  Устанавливаем зелёный цвет на 1 светодиоде и яркость (1,RGB,яркость)
        led.setColor(2, 0x0000FF, i);                //  Устанавливаем синий   цвет на 2 светодиоде и яркость (2,RGB,яркость)
        led.setColor(3, 0xFFFF00, i);                //  Устанавливаем жёлтый  цвет на 3 светодиоде и яркость (3,RGB,яркость)
        led.write(); delay(5);                       //  Записываем и ждём 5 мс, чтоб изменение яркости было плавным
    }
    delay(1000);                                     //  Ждём 1 секунду, чтоб увидеть синий цвет
}
